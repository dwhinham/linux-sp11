## Documentation/devicetree/bindings/input/hid-over-spi.yaml
```yaml
# SPDX-License-Identifier: (GPL-2.0-only OR BSD-2-Clause)
%YAML 1.2
---
$id: http://devicetree.org/schemas/input/hid-over-spi.yaml#
$schema: http://devicetree.org/meta-schemas/core.yaml#

title: HID over SPI Devices

maintainers:
  - Benjamin Tissoires <bentiss@kernel.org>
  - Jiri Kosina <jikos@kernel.org>
  - Jingyuan Liang <jingyliang@chromium.org>

description: |+
  HID over SPI provides support for various Human Interface Devices over the
  SPI bus. These devices can be for example touchpads, keyboards, touch screens
  or sensors.

  The specification has been written by Microsoft and is currently available
  here: https://www.microsoft.com/en-us/download/details.aspx?id=103325

allOf:
  - $ref: /schemas/input/touchscreen/touchscreen.yaml#
  - $ref: /schemas/spi/spi-peripheral-props.yaml#
  - if:
      properties:
        compatible:
          contains:
            const: microsoft,romulus13-touchpad
    then:
      properties:
        spi-max-frequency:
          maximum: 20000000
        spi-rx-bus-width:
          items:
            - const: 4
        spi-tx-bus-width:
          items:
            - const: 4
      required:
        - spi-rx-bus-width
        - spi-tx-bus-width
  - if:
      properties:
        compatible:
          contains:
            const: microsoft,denali-touchscreen
    then:
      properties:
        spi-max-frequency:
          maximum: 40000000
        spi-rx-bus-width:
          items:
            - const: 4
        spi-tx-bus-width:
          items:
            - const: 4
      required:
        - spi-rx-bus-width
        - spi-tx-bus-width

properties:
  compatible:
    enum:
      - microsoft,denali-touchscreen
      - microsoft,g6-touch-digitizer
      - microsoft,romulus13-touchpad

  reg:
    maxItems: 1

  interrupts:
    maxItems: 1

  reset-gpios:
    maxItems: 1
    description:
      GPIO specifier for the device's reset line. The HID over SPI
      specification requires a dedicated, host-driven, active-low reset
      line. The line must be flagged with GPIO_ACTIVE_LOW.

  vdd-supply:
    description:
      Regulator for the VDD supply voltage.

required:
  - compatible
  - reg
  - interrupts
  - reset-gpios
  - vdd-supply

unevaluatedProperties: false

examples:
  - |
    #include <dt-bindings/interrupt-controller/irq.h>
    #include <dt-bindings/gpio/gpio.h>

    spi {
      #address-cells = <1>;
      #size-cells = <0>;

      hid@0 {
        compatible = "microsoft,g6-touch-digitizer";
        reg = <0x0>;
        interrupts-extended = <&gpio 42 IRQ_TYPE_EDGE_FALLING>;
        reset-gpios = <&gpio 27 GPIO_ACTIVE_LOW>;
        vdd-supply = <&pm8350c_l3>;
        pinctrl-names = "default";
        pinctrl-0 = <&ts_d6_int_bias>;
      };
    };
  - |
    #include <dt-bindings/interrupt-controller/irq.h>
    #include <dt-bindings/gpio/gpio.h>

    spi {
      #address-cells = <1>;
      #size-cells = <0>;

      touchpad@0 {
        compatible = "microsoft,romulus13-touchpad";
        reg = <0>;
        spi-max-frequency = <20000000>;
        spi-rx-bus-width = <4>;
        spi-tx-bus-width = <4>;
        interrupts-extended = <&tlmm 3 IRQ_TYPE_LEVEL_LOW>;
        vdd-supply = <&vreg_ts_5p0>;
        reset-gpios = <&tlmm 120 GPIO_ACTIVE_LOW>;
        pinctrl-0 = <&touchpad_reset>;
        pinctrl-names = "default";
      };
    };
```
