// SPDX-License-Identifier: BSD-3-Clause
/*
 * Copyright (c) 2026 Haipeng Lin <jimmie.lin@gmail.com>
 */

/dts-v1/;

#include "x1p64100-microsoft-denali.dts"
#include "x1-microsoft-denali-5g.dtsi"

/ {
	model = "Microsoft Surface Pro 11th Edition (LCD, 5G)";
	compatible = "microsoft,denali-lcd-5g", "microsoft,denali-lcd",
		     "microsoft,denali", "qcom,x1p64100", "qcom,x1e80100";
};
